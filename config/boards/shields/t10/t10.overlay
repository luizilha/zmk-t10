/*
 * Copyright (c) 2022 The ZMK Contributors
 *
 * SPDX-License-Identifier: MIT
 */

/*
 * T10 - 8 key direct-wired macropad on a nice!nano (Pro Micro footprint).
 *
 * Key 1 -> pro_micro 0  (P0.08)   Key 5 -> pro_micro 4  (P0.22)
 * Key 2 -> pro_micro 1  (P0.06)   Key 6 -> pro_micro 5  (P0.24)
 * Key 3 -> pro_micro 2  (P0.17)   Key 7 -> pro_micro 6  (P1.00)
 * Key 4 -> pro_micro 3  (P0.20)   Key 8 -> pro_micro 7  (P0.11)
 *
 * Each switch goes between the pin and GND (internal pull-up enabled).
 * Change the pin numbers below if your wiring is different.
 */

/ {
    chosen {
        zmk,kscan = &kscan0;
    };

    kscan0: kscan {
        compatible = "zmk,kscan-gpio-direct";
        wakeup-source;
        input-gpios =
              <&pro_micro 0 (GPIO_ACTIVE_LOW | GPIO_PULL_UP)>,
              <&pro_micro 1 (GPIO_ACTIVE_LOW | GPIO_PULL_UP)>,
              <&pro_micro 2 (GPIO_ACTIVE_LOW | GPIO_PULL_UP)>,
              <&pro_micro 3 (GPIO_ACTIVE_LOW | GPIO_PULL_UP)>,
              <&pro_micro 4 (GPIO_ACTIVE_LOW | GPIO_PULL_UP)>,
              <&pro_micro 5 (GPIO_ACTIVE_LOW | GPIO_PULL_UP)>,
              <&pro_micro 6 (GPIO_ACTIVE_LOW | GPIO_PULL_UP)>,
              <&pro_micro 7 (GPIO_ACTIVE_LOW | GPIO_PULL_UP)>
            ;
    };
};
